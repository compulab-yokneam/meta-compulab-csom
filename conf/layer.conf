## conf/layer.conf
```bitbake
# We have a conf and classes directory, append to BBPATH
BBPATH .= ":${LAYERDIR}"

# We have a recipes directory containing .bb and .bbappend files, add to BBFILES
BBFILES += "${LAYERDIR}/recipes*/*/*.bb \
            ${LAYERDIR}/recipes*/*/*.bbappend"

BBFILE_COLLECTIONS += "compulab-csom"
BBFILE_PATTERN_compulab-csom := "^${LAYERDIR}/"
BBFILE_PRIORITY_compulab-csom = "13"

LAYERSERIES_COMPAT_compulab-csom = "honister kirkstone"
```
